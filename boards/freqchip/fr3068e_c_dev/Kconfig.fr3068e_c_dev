## boards/freqchip/fr3068e_c_dev/Kconfig.fr3068e_c_dev
```kconfig
# Copyright (c) 2025 Freqchip
# SPDX-License-Identifier: Apache-2.0

config BOARD_FR3068E_C_DEV
	select SOC_FR3068E_C
```

## boards/freqchip/fr3068e_c_dev/board.yml
```yaml
board:
  name: fr3068e_c_dev
  full_name: FR3068E_C_DEV
  vendor: freqchip
  socs:
    - name: fr3068e_c
```

## boards/freqchip/fr3068e_c_dev/fr3068e_c_dev_defconfig
```kconfig
# Copyright (c) 2025 Freqchip
# SPDX-License-Identifier: Apache-2.0

CONFIG_HW_STACK_PROTECTION=y
CONFIG_MAIN_STACK_SIZE=10000

CONFIG_CONSOLE=y
CONFIG_UART_CONSOLE=y
CONFIG_SERIAL=y

CONFIG_USE_DT_CODE_PARTITION=y
```

## drivers/flash/Kconfig.fr
```kconfig
# Copyright (c) 2025 Freqchip
# SPDX-License-Identifier: Apache-2.0

config SOC_FLASH_FREQCHIP_FR
	bool "Freqchip FR30xx flash driver"
	default y
	depends on DT_HAS_FREQCHIP_FR_FLASH_CONTROLLER_ENABLED
	select FLASH_HAS_PAGE_LAYOUT
	select FLASH_HAS_DRIVER_ENABLED
	select FLASH_HAS_EXPLICIT_ERASE
	help
	  Enables Freqchip FR30xx flash driver.
```

## drivers/serial/Kconfig.fr
```kconfig
# Copyright (c) 2025 Freqchip
# SPDX-License-Identifier: Apache-2.0

config UART_FREQCHIP_FR
	bool "freqchip serial driver"
	default y
	depends on DT_HAS_FREQCHIP_FR_UART_ENABLED
	select SERIAL_HAS_DRIVER
	select SERIAL_SUPPORT_INTERRUPT
	help
	  This option enables the UART driver for Freqchip SoC family.
```

## dts/bindings/flash_controller/freqchip,fr-flash-controller.yaml
```yaml
description: Freqchip FR30xx Flash Controller

compatible: "freqchip,fr-flash-controller"

include: flash-controller.yaml
```

## dts/bindings/gpio/freqchip,freqchip-gpio.yaml
```yaml
# Copyright (c) 2025 Freqchip
# SPDX-License-Identifier: Apache-2.0

description: FR30XX/C GPIO Controller

compatible: "freqchip,freqchip-gpio"

include:
  - name: gpio-controller.yaml
    property-blocklist:
      - ngpios
  - name: base.yaml

properties:
  reg:
    required: true

  clocks:
    required: false

  "#gpio-cells":
    const: 2

  ngpios:
    type: int
    default: 16
    description: |
        This property indicates the number of in-use slots of available slots
        for GPIOs. The FREQCHIP GPIO controller typically has all 16 possible port
        IO with few exceptions. It should only be necessary to explicitly set
        this property if the controller itself does not implement all 16 port
        IO register bits; for example PORTB in the FR3066DQ-C series which only
        implements the first 11. Package restrictions on the number of exposed
        GPIO should not influence this property. For cases in which there might
        be holes in the slot range, this value should be the max slot number+1.

gpio-cells:
  - pin
  - flags
```

## dts/bindings/pinctrl/freqchip.fr-pinctrl.yaml
```yaml
# Copyright (c) 2025 Freqchip
# SPDX-License-Identifier: Apache-2.0

description: |
    Freqchip FR30xx Pin IOMUX.
    
compatible: "freqchip,fr-pinctrl"

include: base.yaml

properties:
  reg:
    required: true
    
child-binding:
  description: |
      This binding gives a base representation of the STM32 pins configuration
      
  include:
    - name: pincfg-node.yaml
      property-allowlist:
        - input-enable
        - output-enable
        - bias-high-impedance
        - bias-pull-up
        - bias-pull-down
       
  properties:
    pinmux:
      required: true
      type: array
      description: |
        Freqchip FR30xx-C io Alternate function selection (port, pin and function)
        For example: ['A', 0, 1] means set PA0 to function 1.
```

## dts/bindings/serial/freqchip,fr-uart.yaml
```yaml
# Copyright (c) 2025 Freqchip
# SPDX-License-Identifier: Apache-2.0

description: Freqchip FR UART

compatible: "freqchip,fr-uart"

include: [uart-controller.yaml, pinctrl-device.yaml]

properties:
  reg:
    required: true

  interrupts:
    required: true
```

## modules/Kconfig.freqchip
```kconfig
# Copyright (c) 2025 Freqchip
# SPDX-License-Identifier: Apache-2.0

config HAS_FREQCHIP_DRIVERS
	bool "Freqchip Drivers"
	help
	  This option enables Freqchip Drivers APIs.
```

## soc/freqchip/fr/Kconfig
```kconfig
# Copyright (c) 2024 Freqchip
# SPDX-License-Identifier: Apache-2.0

config SOC_FAMILY_FREQCHIP_FR
	select HAS_FREQCHIP_DRIVERS

if SOC_FAMILY_FREQCHIP_FR

rsource "*/Kconfig"

endif # SOC_FAMILY_FREQCHIP_FR
```

## soc/freqchip/fr/Kconfig.defconfig
```kconfig
# Copyright (c) 2024 Freqchip
# SPDX-License-Identifier: Apache-2.0

if SOC_FAMILY_FREQCHIP_FR

rsource "*/Kconfig.defconfig.series"

endif # SOC_FAMILY_FREQCHIP_FR
```

## soc/freqchip/fr/Kconfig.soc
```kconfig
# Copyright (c) 2024 Freqchip
# SPDX-License-Identifier: Apache-2.0

config SOC_FAMILY_FREQCHIP_FR
	bool

config SOC_FAMILY
	default "freqchip_fr" if SOC_FAMILY_FREQCHIP_FR

rsource "*/Kconfig.soc"
```

## soc/freqchip/fr/fr30xx_c/Kconfig
```kconfig
# Copyright (c) 2025 Freqchip
# SPDX-License-Identifier: Apache-2.0

config SOC_SERIES_FR30XX_C
	select XIP
	select ARM
	select CPU_CORTEX_M33
	select CPU_CORTEX_M_HAS_SYSTICK
	select CPU_CORTEX_M_HAS_VTOR
#	select CPU_HAS_ARM_MPU
	select CPU_HAS_FPU
	select ARMV8_M_DSP
	select SOC_EARLY_INIT_HOOK
	select OUTPUT_DISASSEMBLY

config SYS_CLOCK_HW_CYCLES_PER_SEC
	default $(dt_node_int_prop_int,/cpus/cpu@0,clock-frequency)

config NUM_IRQS
	default 91
```

## soc/freqchip/fr/fr30xx_c/Kconfig.defconfig.series
```kconfig
# Copyright (c) 2025 Freqchip
# SPDX-License-Identifier: Apache-2.0

if SOC_SERIES_FR30XX_C

rsource "Kconfig.defconfig.fr30*"

endif # SOC_SERIES_FR30XX_C
```

## soc/freqchip/fr/fr30xx_c/Kconfig.soc
```kconfig
# Copyright (c) 2025 Freqchip
# SPDX-License-Identifier: Apache-2.0

config SOC_SERIES_FR30XX_C
	bool
	select SOC_FAMILY_FREQCHIP_FR

config SOC_SERIES
	default "fr30xx_c" if SOC_SERIES_FR30XX_C

config SOC_FR3068E_C
	bool
	select SOC_SERIES_FR30XX_C

config SOC
	default "fr3068e_c" if SOC_FR3068E_C
```
